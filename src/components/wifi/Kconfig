## src/components/wifi/Kconfig
```kconfig
menu "Autocirc WiFi Config"

    config ESP_WIFI_SSID
        string "WiFi SSID"
        help
            SSID (network name).

    config ESP_WIFI_PASSWORD
        string "WiFi Password"
        help
            WiFi password (WPA or WPA2).

    config ESP_MAXIMUM_RETRY
        int "Maximum retry"
        default 5
        help
            Set the Maximum retry to avoid station reconnecting to the AP unlimited when the AP is really inexistent.

endmenu
```
